## firmware/boards/tapt/tapt/board.yml
```yaml
board:
  name: tapt
  vendor: tapt
  full_name: Tapt PCB
  revision:
    format: major.minor.patch
    default: "0.1.0"
    revisions:
    - name: "0.1.0"
  socs:
  - name: nrf52810
  
```
